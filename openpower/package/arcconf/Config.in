## openpower/package/arcconf/Config.in
```kconfig
config BR2_PACKAGE_ARCCONF
	bool "arcconf"
	help
	  MicroSemi utilities for SAS controller
```

## openpower/package/devmem-aspeed/Config.in
```kconfig
config BR2_PACKAGE_DEVMEM_ASPEED
	bool "devmem-aspeed"
	depends on BR2_PACKAGE_BUSYBOX_SHOW_OTHERS
	help
	  Simple program to read/write from/to any location in the ASpeed 2400/2500 BMC memory.
```

## openpower/package/hcode/Config.in
```kconfig
config BR2_PACKAGE_HCODE
        bool "hcode"
        default y if (BR2_OPENPOWER_PLATFORM && BR2_OPENPOWER_POWER9)
        select BR2_CPP
        help
            Project to build the HCODE firmware codebase
```

## openpower/package/hostboot-binaries/Config.in
```kconfig
config BR2_PACKAGE_HOSTBOOT_BINARIES
        bool "hostboot_binaries"
        default y if (BR2_OPENPOWER_PLATFORM)
        help
            Project to stage hostboot binary images

if BR2_PACKAGE_HOSTBOOT_BINARIES

choice
	prompt "Hostboot-binaries version"
	default BR2_HOSTBOOT_BINARIES_OP910_VERSION

config BR2_HOSTBOOT_BINARIES_OP910_VERSION
	bool "Use the latest OP910 HOSTBOOT_BINARIES stable version"

config BR2_HOSTBOOT_BINARIES_OP920_VERSION
	bool "Use latest HOSTBOOT_BINARIES stable version (OP920)"

config BR2_HOSTBOOT_BINARIES_LATEST_VERSION
	bool "Use latest HOSTBOOT_BINARIES master"

config BR2_HOSTBOOT_BINARIES_CUSTOM_VERSION
	bool "Custom HOSTBOOT_BINARIES version"

endchoice

config BR2_HOSTBOOT_BINARIES_CUSTOM_VERSION_VALUE
	string "HOSTBOOT_BINARIES version"
	depends on BR2_HOSTBOOT_BINARIES_CUSTOM_VERSION

config BR2_HOSTBOOT_BINARIES_VERSION
	string
	default "81d8233a6dc8b79451c326c9dae6581e310f6cd2" if BR2_HOSTBOOT_BINARIES_LATEST_VERSION
	default "90161253d6a8768c035de8286a3acea47cb98064" if BR2_HOSTBOOT_BINARIES_OP910_VERSION
	default "hw112818a.op920" if BR2_HOSTBOOT_BINARIES_OP920_VERSION
	default BR2_HOSTBOOT_BINARIES_CUSTOM_VERSION_VALUE \
		if BR2_HOSTBOOT_BINARIES_CUSTOM_VERSION

endif
```

## openpower/package/hostboot/Config.in
```kconfig
config BR2_PACKAGE_HOSTBOOT
        bool "hostboot"
        default y if (BR2_OPENPOWER_POWER9)
        select BR2_CPP
        help
            Project to build the hostboot firmware codebase

if BR2_PACKAGE_HOSTBOOT

choice
	prompt "Hostboot version"
	default BR2_HOSTBOOT_LATEST_VERSION

config BR2_HOSTBOOT_LATEST_VERSION
	bool "Use latest Hostboot master"

config BR2_HOSTBOOT_CUSTOM_VERSION
	bool "Custom version"

endchoice

config BR2_HOSTBOOT_CUSTOM_VERSION_VALUE
	string "hostboot version"
	depends on BR2_HOSTBOOT_CUSTOM_VERSION

config BR2_HOSTBOOT_VERSION
	string
	default "82e592285a256a2b4ceb084bab3928dfe2ec0757" if BR2_HOSTBOOT_LATEST_VERSION
	default BR2_HOSTBOOT_CUSTOM_VERSION_VALUE \
		if BR2_HOSTBOOT_CUSTOM_VERSION

config BR2_HOSTBOOT_CONFIG_FILE
        string "Hostboot configuration file for compilation"
        default default
        help
            String used to define hw specific make config file

endif
```

## openpower/package/sbe/Config.in
```kconfig
config BR2_PACKAGE_SBE
        bool "sbe"
        default y if (BR2_OPENPOWER_PLATFORM && BR2_OPENPOWER_POWER9)
        select BR2_CPP
        depends on BR2_PACKAGE_HCODE
        help
            Project to build the sbe firmware codebase

if BR2_PACKAGE_SBE

choice
	prompt "SBE version"
	default BR2_SBE_LATEST_VERSION

config BR2_SBE_LATEST_VERSION
	bool "Use latest SBE master"

config BR2_SBE_CUSTOM_VERSION
	bool "Custom SBE version"

endchoice

config BR2_SBE_CUSTOM_VERSION_VALUE
	string "SBE version"
	depends on BR2_SBE_CUSTOM_VERSION

config BR2_SBE_VERSION
	string
	default "47abe2a55e6337cebececdb8b57c1d9c238e6d18" if BR2_SBE_LATEST_VERSION
	default BR2_SBE_CUSTOM_VERSION_VALUE \
		if BR2_SBE_CUSTOM_VERSION

endif
```
